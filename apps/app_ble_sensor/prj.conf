## CMakeLists.txt
```
cmake_minimum_required(VERSION 3.20.0)

find_package(Zephyr REQUIRED HINTS $ENV{ZEPHYR_BASE})
project(app_ble_sensor)

# Add the shared library subdirectory so CMake builds it first
add_subdirectory(../../shared ../../shared)

# Include shared headers
target_include_directories(app PRIVATE
    ../../shared/include
    ../../shared/hal/gpio
    ../../shared/hal/adc
    ../../shared/hal/pwm
    ../../shared/hal/timer
    ../../shared/hal/rtc
    ../../shared/hal/watchdog
    ../../shared/hal/flash
    ../../shared/hal/rng
    ../../shared/hal/system
    ../../shared/hal/power
    ../../shared/drivers/uart
    ../../shared/drivers/spi
    ../../shared/drivers/i2c
    ../../shared/drivers/i2s
    ../../shared/drivers/imu
    ../../shared/drivers/ble
    ../../shared/drivers/usb_cdc
    ../../shared/drivers/nfc
    ../../shared/drivers/rgb_led
    ../../shared/drivers/battery
    ../../shared/drivers/button
    ../../shared/drivers/microphone
    src
)

target_sources(app PRIVATE
    src/main.c
    src/ekf.c
)

# Link necessary driver libraries
target_link_libraries(app PRIVATE
    shared_utils
    shared_hal
    shared_imu
    shared_ble
    shared_rgb_led
    shared_microphone
)
```

## sysbuild.conf
```
# Disable MCUboot bootloader image generation in sysbuild
SB_CONFIG_BOOTLOADER_MCUBOOT=n
```

## prj.conf
```kconfig
# Application Configuration for app_ble_sensor

# GPIO & System
CONFIG_GPIO=y
CONFIG_I2C=y
CONFIG_SENSOR=y
CONFIG_REGULATOR=y
CONFIG_REGULATOR_FIXED=y

# Enable Audio & Digital Microphone (DMIC) Subsystems
CONFIG_AUDIO=y
CONFIG_AUDIO_DMIC=y

# LSM6DSL IMU Sensor Output Data Rates (52Hz - Power ON Accel & Gyro)
CONFIG_LSM6DSL_ACCEL_ODR=3
CONFIG_LSM6DSL_GYRO_ODR=3

# Bluetooth Stack & Device Name
CONFIG_BT=y
CONFIG_BT_SMP=y
CONFIG_BT_PERIPHERAL=y
CONFIG_BT_DEVICE_NAME="se3dstudio_imu_01"

# BLE Throughput, MTU, and TX Buffer Optimizations
CONFIG_BT_BUF_ACL_TX_SIZE=251
CONFIG_BT_L2CAP_TX_MTU=247
CONFIG_BT_BUF_ACL_RX_SIZE=251
CONFIG_BT_BUF_ACL_TX_COUNT=32
CONFIG_BT_BUF_EVT_RX_COUNT=35
CONFIG_BT_CONN_TX_MAX=32
CONFIG_BT_L2CAP_TX_BUF_COUNT=32
CONFIG_BT_USER_PHY_UPDATE=y
CONFIG_BT_USER_DATA_LEN_UPDATE=y

# Enable Logging
CONFIG_LOG=y
CONFIG_LOG_DEFAULT_LEVEL=3

# Disable Bootloader, MCUboot, DFU, OTA, and MCUMGR options
CONFIG_BOOTLOADER_MCUBOOT=n
CONFIG_MCUBOOT_BOOTUTIL_LIB=n
CONFIG_MCUBOOT_IMG_MANAGER=n
CONFIG_IMG_MANAGER=n
CONFIG_MCUMGR=n
CONFIG_DFU_TARGET=n
CONFIG_UPDATEHUB=n
CONFIG_HAWKBIT=n

# Build UF2 binary for direct drag-and-drop / copying to board
CONFIG_BUILD_OUTPUT_UF2=y
CONFIG_USE_DT_CODE_PARTITION=y
```

## app.overlay
```dts
/* Disable UICR gpio-as-nreset */
&uicr {
	/delete-property/ gpio-as-nreset;
};

/* Enable PDM0 Digital Microphone Peripheral */
&pdm0 {
	status = "okay";
};
```

## src/main.c
```c
#include <zephyr/kernel.h>
#include <zephyr/init.h>
#include <zephyr/logging/log.h>
#include <hal/nrf_gpio.h>
#include "imu_driver.h"
#include "ble_driver.h"
#include "rgb_led_driver.h"
#include "mic_driver.h"
#include "ekf.h"

LOG_MODULE_REGISTER(app_ble_sensor, LOG_LEVEL_INF);

#define SAMPLE_PERIOD_MS 33 // ~30Hz IMU loop
#define PCM_BLOCK_SAMPLES 256 // 256 samples of 16-bit PCM (512 bytes)
#define ADPCM_BLOCK_BYTES 128 // 256 samples compressed to 128 4-bit ADPCM bytes

static const int indexTable[16] = {
    -1, -1, -1, -1, 2, 4, 6, 8,
    -1, -1, -1, -1, 2, 4, 6, 8
};

static const int stepsizeTable[89] = {
    7, 8, 9, 10, 11, 12, 13, 14, 16, 17,
    19, 21, 23, 25, 28, 31, 34, 37, 41, 45,
    50, 55, 60, 66, 73, 80, 88, 97, 107, 118,
    130, 143, 157, 173, 190, 209, 230, 253, 279, 307,
    337, 371, 408, 449, 494, 544, 598, 658, 724, 796,
    876, 963, 1060, 1166, 1282, 1411, 1552, 1707, 1878, 2066,
    2272, 2499, 2749, 3024, 3326, 3659, 4025, 4428, 4871, 5358,
    5894, 6484, 7132, 7845, 8630, 9493, 10442, 11487, 12635, 13899,
    15289, 16818, 18500, 20350, 22385, 24623, 27086, 29794, 32767
};

struct adpcm_state {
    int16_t valprev;
    int8_t index;
};

static uint8_t adpcm_encode_sample(int16_t sample, struct adpcm_state *state)
{
    int diff = sample - state->valprev;
    int step = stepsizeTable[state->index];
    int code = 0;
    int tempstep = step;

    if (diff < 0) {
        code = 8;
        diff = -diff;
    }

    if (diff >= tempstep) {
        code |= 4;
        diff -= tempstep;
    }
    tempstep >>= 1;
    if (diff >= tempstep) {
        code |= 2;
        diff -= tempstep;
    }
    tempstep >>= 1;
    if (diff >= tempstep) {
        code |= 1;
    }

    int vpdiff = step >> 3;
    if (code & 4) vpdiff += step;
    if (code & 2) vpdiff += step >> 1;
    if (code & 1) vpdiff += step >> 2;

    if (code & 8) {
        state->valprev -= vpdiff;
    } else {
        state->valprev += vpdiff;
    }

    if (state->valprev > 32767) state->valprev = 32767;
    else if (state->valprev < -32768) state->valprev = -32768;

    state->index += indexTable[code & 7];
    if (state->index < 0) state->index = 0;
    else if (state->index > 88) state->index = 88;

    return code;
}

static void adpcm_encode_block(const int16_t *pcm, size_t len, uint8_t *encoded, struct adpcm_state *state)
{
    for (size_t i = 0; i < len; i += 2) {
        uint8_t code1 = adpcm_encode_sample(pcm[i], state);
        uint8_t code2 = adpcm_encode_sample(pcm[i + 1], state);
        encoded[i / 2] = (code2 << 4) | (code1 & 0x0F);
    }
}

K_THREAD_STACK_DEFINE(mic_stack_area, 2048);
static struct k_thread mic_thread_data;
static volatile bool mic_active = false;

static int16_t pcm_buf[PCM_BLOCK_SAMPLES];
static uint8_t adpcm_buf[ADPCM_BLOCK_BYTES];
static struct adpcm_state compress_state;

/* Early power-on hardware hook at PRE_KERNEL_1 */
static int early_power_on_hardware(void)
{
    // On XIAO BLE Sense, P1.08 LOW (0) powers ON the LSM6DS3TR-C IMU regulator (P-FET)
    nrf_gpio_cfg_output(NRF_GPIO_PIN_MAP(1, 8));
    nrf_gpio_pin_write(NRF_GPIO_PIN_MAP(1, 8), 0);
    
    // On XIAO BLE Sense, P1.10 HIGH (1) powers ON the MSM261D3526H PDM microphone regulator
    nrf_gpio_cfg_output(NRF_GPIO_PIN_MAP(1, 10));
    nrf_gpio_pin_write(NRF_GPIO_PIN_MAP(1, 10), 1);

    return 0;
}

SYS_INIT(early_power_on_hardware, PRE_KERNEL_1, 0);

static inline float sensor_val_to_float(const struct sensor_value *val)
{
    return (float)val->val1 + (float)val->val2 / 1000000.0f;
}

static void on_ble_write(const uint8_t *data, uint16_t len)
{
    if (len > 0 && data[0] == 0x01) {
        LOG_INF("Received Gyro Calibration Command from BLE Client");
        ekf_start_calibration();
    }
}

/* Dedicated Microphone Thread with BLE TX Buffer Flow Control */
static void mic_thread_entry(void *p1, void *p2, void *p3)
{
    ARG_UNUSED(p1);
    ARG_UNUSED(p2);
    ARG_UNUSED(p3);

    LOG_INF("ADPCM Audio Microphone worker thread started");

    while (1) {
        if (ble_drv_is_connected() && ble_drv_is_audio_notify_enabled()) {
            if (!mic_active) {
                memset(&compress_state, 0, sizeof(compress_state));
                int ret = mic_drv_start();
                if (ret == 0) {
                    mic_active = true;
                    LOG_INF("Microphone PDM ADPCM stream started");
                } else {
                    LOG_ERR("Failed to start mic driver: %d", ret);
                    k_msleep(200);
                    continue;
                }
            }

            // Read 256 PCM samples (512 bytes, blocks for ~16ms while buffer fills)
            int ret = mic_drv_read(pcm_buf, PCM_BLOCK_SAMPLES);
            if (ret == 0) {
                // Compress 256 16-bit PCM samples to 128 4-bit ADPCM bytes
                adpcm_encode_block(pcm_buf, PCM_BLOCK_SAMPLES, adpcm_buf, &compress_state);

                // Stream 128 bytes ADPCM packet over BLE
                int notify_ret = ble_drv_notify_audio(adpcm_buf, sizeof(adpcm_buf));
                if (notify_ret < 0) {
                    // If BLE TX buffers full, yield briefly for radio transmission
                    k_msleep(15);
                }
            } else {
                k_msleep(10);
            }
        } else {
            if (mic_active) {
                mic_drv_stop();
                mic_active = false;
                LOG_INF("Microphone stream stopped");
            }
            k_msleep(100);
        }
    }
}

int main(void)
{
    int ret;

    // Delay for hardware power rail stabilization
    k_msleep(100);

    LOG_INF("Starting Seeed Studio XIAO nRF52840 BLE IMU + ADPCM Audio Application...");

    // Initialize RGB LED driver
    ret = rgb_led_init();
    if (ret < 0) {
        LOG_ERR("Failed to initialize RGB LED driver: %d", ret);
    }
    rgb_led_set(true, false, false);

    // Initialize IMU driver
    ret = imu_driver_init();
    if (ret < 0) {
        LOG_ERR("Failed to initialize IMU driver: %d", ret);
    }

    // Initialize Extended Kalman Filter
    ekf_init();

    // Initialize PDM Microphone driver
    ret = mic_drv_init();
    if (ret < 0) {
        LOG_ERR("Failed to initialize microphone driver: %d", ret);
    }

    // Start dedicated Preemptible ADPCM Microphone Thread
    k_thread_create(&mic_thread_data, mic_stack_area,
                    K_THREAD_STACK_SIZEOF(mic_stack_area),
                    mic_thread_entry, NULL, NULL, NULL,
                    K_PRIO_PREEMPT(8), 0, K_NO_WAIT);

    // Initialize BLE driver
    ret = ble_drv_init();
    if (ret < 0) {
        LOG_ERR("Failed to initialize BLE driver: %d", ret);
    }

    // Set BLE write callback for calibration commands
    ble_drv_set_write_cb(on_ble_write);

    // Start BLE Advertising as se3dstudio_imu_01
    ret = ble_drv_adv_start("se3dstudio_imu_01");
    if (ret < 0) {
        LOG_ERR("Failed to start BLE advertising: %d", ret);
    }

    struct imu_data raw_imu;
    imu_ble_payload_t payload;
    uint32_t cal_blink_counter = 0;
    bool cal_green_flash = false;

    // Main 30Hz IMU loop
    while (1) {
        ret = imu_driver_fetch(&raw_imu);
        if (ret == 0) {
            float ax = sensor_val_to_float(&raw_imu.accel[0]);
            float ay = sensor_val_to_float(&raw_imu.accel[1]);
            float az = sensor_val_to_float(&raw_imu.accel[2]);
            float gx = sensor_val_to_float(&raw_imu.gyro[0]);
            float gy = sensor_val_to_float(&raw_imu.gyro[1]);
            float gz = sensor_val_to_float(&raw_imu.gyro[2]);

            if (ekf_is_calibrating()) {
                bool cal_done = ekf_update_calibration(gx, gy, gz);

                cal_blink_counter++;
                if ((cal_blink_counter / 5) % 2 == 0) {
                    rgb_led_set(true, true, false); // Yellow
                } else {
                    rgb_led_set(false, false, false); // OFF
                }

                if (cal_done) {
                    LOG_INF("Gyro Calibration Complete!");
                    rgb_led_set(false, true, false);
                    cal_green_flash = true;
                    k_msleep(500);
                }
            } else {
                ekf_update(ax, ay, az, gx, gy, gz, (float)SAMPLE_PERIOD_MS / 1000.0f);
                ekf_get_angles(&payload.roll, &payload.pitch, &payload.yaw);

                payload.accel_x = ax;
                payload.accel_y = ay;
                payload.accel_z = az;
                payload.gyro_x = gx;
                payload.gyro_y = gy;
                payload.gyro_z = gz;

                if (ble_drv_is_connected()) {
                    ble_drv_notify((const uint8_t *)&payload, sizeof(payload));
                    if (!cal_green_flash) {
                        rgb_led_set(false, false, true); // Blue = Connected
                    }
                } else {
                    if (!cal_green_flash) {
                        rgb_led_set(true, false, false); // Red = Disconnected
                    }
                }
                cal_green_flash = false;
            }
        } else {
            imu_driver_init();
            if (ble_drv_is_connected()) {
                rgb_led_set(false, false, true);
            } else {
                rgb_led_set(true, false, false);
            }
        }

        k_msleep(SAMPLE_PERIOD_MS);
    }

    return 0;
}
```

## src/ekf.c
```c
#include "ekf.h"
#include <math.h>
#include <string.h>

#define M_PI_F 3.14159265358979323846f

/* Quaternion state vector */
static float q0 = 1.0f, q1 = 0.0f, q2 = 0.0f, q3 = 0.0f;

/* Gyroscope biases (rad/s) */
static float gyro_bias_x = 0.0f;
static float gyro_bias_y = 0.0f;
static float gyro_bias_z = 0.0f;

/* Filter gains */
static const float Kp = 1.0f; // Proportional gain for accel feedback
static const float Ki = 0.005f; // Integral gain

static float eIntX = 0.0f, eIntY = 0.0f, eIntZ = 0.0f;

/* Calibration state */
static bool calibrating = false;
static uint16_t cal_samples = 0;
#define CAL_TOTAL_SAMPLES 90 // ~3 seconds at 30Hz

static float cal_sum_gx = 0.0f;
static float cal_sum_gy = 0.0f;
static float cal_sum_gz = 0.0f;

void ekf_init(void)
{
    q0 = 1.0f;
    q1 = 0.0f;
    q2 = 0.0f;
    q3 = 0.0f;
    
    eIntX = 0.0f;
    eIntY = 0.0f;
    eIntZ = 0.0f;

    gyro_bias_x = 0.0f;
    gyro_bias_y = 0.0f;
    gyro_bias_z = 0.0f;
    
    calibrating = false;
    cal_samples = 0;
}

void ekf_start_calibration(void)
{
    calibrating = true;
    cal_samples = 0;
    cal_sum_gx = 0.0f;
    cal_sum_gy = 0.0f;
    cal_sum_gz = 0.0f;
}

bool ekf_is_calibrating(void)
{
    return calibrating;
}

bool ekf_update_calibration(float gx, float gy, float gz)
{
    if (!calibrating) {
        return false;
    }

    cal_sum_gx += gx;
    cal_sum_gy += gy;
    cal_sum_gz += gz;
    cal_samples++;

    if (cal_samples >= CAL_TOTAL_SAMPLES) {
        gyro_bias_x = cal_sum_gx / (float)CAL_TOTAL_SAMPLES;
        gyro_bias_y = cal_sum_gy / (float)CAL_TOTAL_SAMPLES;
        gyro_bias_z = cal_sum_gz / (float)CAL_TOTAL_SAMPLES;
        
        calibrating = false;
        return true; // Completed
    }

    return false;
}

void ekf_update(float ax, float ay, float az, float gx, float gy, float gz, float dt)
{
    // Subtract bias offset
    gx -= gyro_bias_x;
    gy -= gyro_bias_y;
    gz -= gyro_bias_z;

    float norm = sqrtf(ax * ax + ay * ay + az * az);
    if (norm > 0.0001f) {
        ax /= norm;
        ay /= norm;
        az /= norm;

        // Estimated direction of gravity from quaternion state
        float vx = 2.0f * (q1 * q3 - q0 * q2);
        float vy = 2.0f * (q0 * q1 + q2 * q3);
        float vz = q0 * q0 - q1 * q1 - q2 * q2 + q3 * q3;

        // Cross product error between estimated gravity and accelerometer vector
        float ex = (ay * vz - az * vy);
        float ey = (az * vx - ax * vz);
        float ez = (ax * vy - ay * vx);

        // Integral error
        if (Ki > 0.0f) {
            eIntX += ex * dt;
            eIntY += ey * dt;
            eIntZ += ez * dt;
        } else {
            eIntX = 0.0f;
            eIntY = 0.0f;
            eIntZ = 0.0f;
        }

        // Apply feedback to gyro measurements
        gx += Kp * ex + Ki * eIntX;
        gy += Kp * ey + Ki * eIntY;
        gz += Kp * ez + Ki * eIntZ;
    }

    // Integrate quaternion rate of change
    float q0_dot = 0.5f * (-q1 * gx - q2 * gy - q3 * gz);
    float q1_dot = 0.5f * ( q0 * gx + q2 * gz - q3 * gy);
    float q2_dot = 0.5f * ( q0 * gy - q1 * gz + q3 * gx);
    float q3_dot = 0.5f * ( q0 * gz + q1 * gy - q2 * gx);

    q0 += q0_dot * dt;
    q1 += q1_dot * dt;
    q2 += q2_dot * dt;
    q3 += q3_dot * dt;

    // Normalize quaternion
    norm = sqrtf(q0 * q0 + q1 * q1 + q2 * q2 + q3 * q3);
    if (norm > 0.0001f) {
        q0 /= norm;
        q1 /= norm;
        q2 /= norm;
        q3 /= norm;
    }
}

void ekf_get_angles(float *roll, float *pitch, float *yaw)
{
    if (roll) {
        *roll = atan2f(2.0f * (q0 * q1 + q2 * q3), 1.0f - 2.0f * (q1 * q1 + q2 * q2)) * (180.0f / M_PI_F);
    }
    if (pitch) {
        float sinp = 2.0f * (q0 * q2 - q3 * q1);
        if (fabsf(sinp) >= 1.0f) {
            *pitch = copysignf(90.0f, sinp);
        } else {
            *pitch = asinf(sinp) * (180.0f / M_PI_F);
        }
    }
    if (yaw) {
        *yaw = atan2f(2.0f * (q0 * q3 + q1 * q2), 1.0f - 2.0f * (q2 * q2 + q3 * q3)) * (180.0f / M_PI_F);
    }
}
```

## src/ekf.h
```c
#ifndef EKF_H
#define EKF_H

#include <stdbool.h>
#include <stdint.h>

/**
 * @brief Structure holding IMU payload values to be streamed over BLE.
 */
typedef struct __attribute__((packed)) {
    float roll;     // Degrees
    float pitch;    // Degrees
    float yaw;      // Degrees
    float accel_x;  // m/s^2
    float accel_y;  // m/s^2
    float accel_z;  // m/s^2
    float gyro_x;   // rad/s
    float gyro_y;   // rad/s
    float gyro_z;   // rad/s
} imu_ble_payload_t;

/**
 * @brief Initialize the Extended Kalman / Quaternion Filter module.
 */
void ekf_init(void);

/**
 * @brief Update orientation state with raw accelerometer (m/s^2) and gyroscope (rad/s) measurements.
 * 
 * @param ax Accel X (m/s^2)
 * @param ay Accel Y (m/s^2)
 * @param az Accel Z (m/s^2)
 * @param gx Gyro X (rad/s)
 * @param gy Gyro Y (rad/s)
 * @param gz Gyro Z (rad/s)
 * @param dt Sampling period (seconds)
 */
void ekf_update(float ax, float ay, float az, float gx, float gy, float gz, float dt);

/**
 * @brief Get the fused orientation angles in degrees.
 * 
 * @param roll Pointer to store roll angle (-180 to +180 deg)
 * @param pitch Pointer to store pitch angle (-90 to +90 deg)
 * @param yaw Pointer to store yaw angle (-180 to +180 deg)
 */
void ekf_get_angles(float *roll, float *pitch, float *yaw);

/**
 * @brief Start a gyroscope calibration routine (requires board to be stationary).
 */
void ekf_start_calibration(void);

/**
 * @brief Check if gyro bias calibration is currently active.
 * 
 * @return true if calibrating, false otherwise.
 */
bool ekf_is_calibrating(void);

/**
 * @brief Process a gyro measurement sample during calibration.
 * 
 * @param gx Gyro X (rad/s)
 * @param gy Gyro Y (rad/s)
 * @param gz Gyro Z (rad/s)
 * @return true when calibration completes successfully, false if still gathering samples.
 */
bool ekf_update_calibration(float gx, float gy, float gz);

#endif // EKF_H
```
